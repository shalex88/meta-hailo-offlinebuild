## conf/layer.conf
```bitbake
# We have a conf and classes directory, add to BBPATH
BBPATH .= ":${LAYERDIR}"

# Always include libhailort recipes
BBFILES += "${LAYERDIR}/recipes-libhailort/recipes-*/*/*.bb \
            ${LAYERDIR}/recipes-libhailort/recipes-*/*/*.bbappend "

BBFILE_COLLECTIONS += "meta-hailo-offlinebuild"
BBFILE_PATTERN_meta-hailo-offlinebuild = "^${LAYERDIR}/"
BBFILE_PRIORITY_meta-hailo-offlinebuild = "8"

LICENSE_PATH = "${LAYERDIR}/licenses/"

LAYERDEPENDS_meta-hailo-offlinebuild = "core"
LAYERSERIES_COMPAT_meta-hailo-offlinebuild = "hardknott"
```
